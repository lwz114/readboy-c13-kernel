## arch/arm64/configs/readboy_c13_defconfig
```kconfig
# CONFIG_SERIAL_MAX3100 is not set
# CONFIG_SERIAL_MAX310X is not set
# CONFIG_SERIAL_MFD_HSU is not set
CONFIG_SERIAL_CORE=y
# CONFIG_SERIAL_JSM is not set
CONFIG_SERIAL_MSM_HS=y
# CONFIG_DRV2604 is not set
```
